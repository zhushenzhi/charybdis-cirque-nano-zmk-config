#include "charybdis_cirque.dtsi" // Notice that the main dtsi files are included in the overlay.

&default_transform {
    col-offset = <0>;
};

&kscan0 {
        col-gpios
            = <&pro_micro 16 GPIO_ACTIVE_HIGH> // row 5  (0,5,R)
            , <&pro_micro 14 GPIO_ACTIVE_HIGH> // row 6  (0,6,R)
            , <&pro_micro 15 GPIO_ACTIVE_HIGH> // row 7  (0,7,R)
            , <&pro_micro 18 GPIO_ACTIVE_HIGH> // row 8  (0,8,R)
            , <&pro_micro 19 GPIO_ACTIVE_HIGH> // row 9  (0,9,R)
            ;
};
