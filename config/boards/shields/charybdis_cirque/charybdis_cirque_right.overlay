#include "charybdis_cirque.dtsi"

&default_transform {
    col-offset = <6>;
};

&kscan0 {
    diode-direction = "col2row";
    col-gpios
    = <&pro_micro 19 GPIO_ACTIVE_HIGH> // COL0 
    , <&pro_micro 20 GPIO_ACTIVE_HIGH> // COL1 
    , <&pro_micro 10 GPIO_ACTIVE_HIGH> // COL2 
    , <&pro_micro 6 GPIO_ACTIVE_HIGH> // COL3 
    , <&pro_micro 7 GPIO_ACTIVE_HIGH> // COL1 
    , <&pro_micro 8 GPIO_ACTIVE_HIGH> // COL2 
    ;
};
// &nice_nano_spi {
//     status = "okay";
// };
// &trackpad {
//     status = "okay";
// };


&pro_micro_spi {
	compatible = "nordic,nrf-spim";
    status = "okay";

    miso-pin = <43>; // P0.17
    mosi-pin = <10>; // P0.20
    sck-pin = <45>; // P0.22
    cs-gpios = <&gpio0 23 GPIO_ACTIVE_LOW>; // P0.24

    trackball: trackball@0 {
        compatible = "pixart,pmw33xx";
        reg = <0>;
        label = "Pixart PMW3360";
        cs-gpios = <&gpio0 23 GPIO_ACTIVE_LOW>; // P0.24
        // motswk-gpios = <&gpio1 0 GPIO_ACTIVE_LOW>; // P1.00 = 32 + 0
        spi-max-frequency = <10000000>;
        cpi = <600>;
    };
};






