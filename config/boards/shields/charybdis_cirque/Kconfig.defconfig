## config/boards/shields/charybdis_cirque/Kconfig.defconfig
```kconfig
if SHIELD_CHARYBDIS_CIRQUE_LEFT

    config ZMK_KEYBOARD_NAME
        default "Skeletyl_L"

endif

if SHIELD_CHARYBDIS_CIRQUE_RIGHT

    config ZMK_KEYBOARD_NAME
        default "Charybdis_Cir_R"
    
    config ZMK_SPLIT_BLE_ROLE_CENTRAL
        default y

endif

if SHIELD_CHARYBDIS_CIRQUE_LEFT || SHIELD_CHARYBDIS_CIRQUE_RIGHT

    config ZMK_SPLIT
        default y

endif
```

## config/west.yml
```yaml
manifest:
  remotes:
    - name: zmkfirmware
      url-base: https://github.com/ALpotato
  projects:
    - name: zmk
      remote: zmkfirmware
      revision: EricDracula-trackpad
      import: app/west.yml
  self:
    path: config
```
